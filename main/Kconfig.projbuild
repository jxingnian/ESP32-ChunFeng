## main/Kconfig.projbuild
```kconfig
menu "ChunFeng Configuration"

    config ESP_WIFI_SSID
        string "WiFi SSID"
        default "ChunFeng"
        help
            SSID (network name) for the example to connect to.

    config ESP_WIFI_PASSWORD
        string "WiFi Password"
        default "12345678"
        help
            WiFi password (WPA or WPA2) for the example to use.
    config ESP_WIFI_CHANNEL
        int "WiFi Channel"
        range 1 13
        default 1
        help
            WiFi channel (network channel) for the example to use.

    config ESP_MAX_STA_CONN
        int "Maximal STA connections"
        default 4
        help
            Max number of the STA connects to AP.
    #
    # 选择如何触发音频对话
    #
    choice
        # 音频对话触发模式选择
        prompt "Audio Conversation Trigger Mode"
        default CONTINUOUS_CONVERSATION_MODE
    
    config VOICE_WAKEUP_MODE
        bool "Wake Word Mode"
        select SR_WN_WN9_HILEXIN
        help
            # 系统通过预定义的唤醒词(例如"Hi Lexin")来激活
            System is activated by a predefined wake word (e.g. 'Hi Lexin').
    
    config CONTINUOUS_CONVERSATION_MODE
        bool "Continuous Mode"
        help
            # 系统在初始触发后保持活跃状态以进行持续对话
            Keeps the system active after the initial trigger for ongoing conversation.
    
    endchoice
    
    # COZE机器人ID配置
    config COZE_BOT_ID
        string "COZE_BOT_ID"
        default "7239506**************"
    
    # COZE访问令牌配置 
    config COZE_ACCESS_TOKEN
        string "COZE_ACCESS_TOKEN"
        default "pat_******************"        
endmenu
```
